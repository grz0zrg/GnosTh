## uboot/rpi_0_config/rpi_0_defconfig
```kconfig
CONFIG_ARM=y
#CONFIG_LTO=y
CONFIG_ARCH_CPU_INIT=y
CONFIG_ARCH_BCM283X=y
CONFIG_TEXT_BASE=0x00008000
CONFIG_SYS_MALLOC_F_LEN=0x400
CONFIG_TARGET_RPI_0_W=y
CONFIG_NR_DRAM_BANKS=1
CONFIG_HAS_CUSTOM_SYS_INIT_SP_ADDR=y
CONFIG_CUSTOM_SYS_INIT_SP_ADDR=0x7ffff00
CONFIG_ENV_SIZE=0x4000
CONFIG_DEFAULT_DEVICE_TREE="bcm2835-rpi-zero"
CONFIG_OF_LIBFDT_OVERLAY=y
CONFIG_SYS_LOAD_ADDR=0x1000000
CONFIG_BOOTSTD_DEFAULTS=y
CONFIG_OF_BOARD_SETUP=y
CONFIG_FDT_SIMPLEFB=y
CONFIG_USE_PREBOOT=y
CONFIG_SYS_PBSIZE=1049
# CONFIG_DISPLAY_CPUINFO is not set
# CONFIG_DISPLAY_BOARDINFO is not set
CONFIG_MISC_INIT_R=y
CONFIG_SYS_PROMPT=">"
CONFIG_CMD_GPIO=y
CONFIG_CMD_MMC=y
CONFIG_CMD_USB=y
CONFIG_CMD_FS_UUID=y
CONFIG_OF_EMBED=y
CONFIG_ENV_FAT_DEVICE_AND_PART="0:1"
CONFIG_SYS_RELOC_GD_ENV_ADDR=y
CONFIG_ENV_VARS_UBOOT_RUNTIME_CONFIG=y
CONFIG_TFTP_TSIZE=y
CONFIG_BCM2835_GPIO=y
CONFIG_MMC_SDHCI=y
CONFIG_MMC_SDHCI_BCM2835=y
CONFIG_PINCTRL=y
# CONFIG_PINCTRL_GENERIC is not set
# CONFIG_REQUIRE_SERIAL_CONSOLE is not set
CONFIG_SYSINFO=y
CONFIG_SYSINFO_SMBIOS=y
CONFIG_USB=y
CONFIG_USB_DWC2=y
CONFIG_USB_KEYBOARD=y
CONFIG_USB_HOST_ETHER=n
CONFIG_USB_ETHER_SMSC95XX=n
CONFIG_VIDEO=y
#CONFIG_SERIAL=n
#CONFIG_DM_SERIAL=n
# CONFIG_VIDEO_BPP8 is not set
# CONFIG_VIDEO_BPP16 is not set
CONFIG_SYS_WHITE_ON_BLACK=y
CONFIG_VIDEO_BCM2835=y
CONFIG_CONSOLE_SCROLL_LINES=10
CONFIG_PHYS_TO_BUS=y
# CONFIG_EFI_LOADER=y
CONFIG_BOOTCOMMAND="printenv api_address;usb start;fatload mmc 0:1 ${kernel_addr_r} gnos.bin;go ${kernel_addr_r}"
CONFIG_CC_OPTIMIZE_LIBS_FOR_SPEED=y
CONFIG_CC_OPTIMIZE_FOR_SPEED=y
CONFIG_ARCH_FIXUP_FDT_MEMORY=n
CONFIG_CC_OPTIMIZE_FOR_SIZE=n
CONFIG_BOOTSTD_BOOTCOMMAND=n
CONFIG_LEGACY_IMAGE_FORMAT=n
CONFIG_SYS_DEVICE_NULLDEV=n
CONFIG_OF_LIBFDT_OVERLAY=n
CONFIG_CMD_BLOCK_CACHE=n
CONFIG_TOOLS_LIBCRYPTO=n
CONFIG_CMDLINE_EDITING=n
CONFIG_CMD_VIDCONSOLE=n
CONFIG_SYSINFO_SMBIOS=n
CONFIG_TOOLS_KWBIMAGE=n
CONFIG_USB_HOST_ETHER=n
CONFIG_OF_BOARD_SETUP=n
CONFIG_AUTO_COMPLETE=n
CONFIG_SYSINFO_EXTRA=y
CONFIG_ISO_PARTITION=n
CONFIG_EFI_PARTITION=n
CONFIG_BOOTM_VXWORKS=n
CONFIG_BOOTM_NETBSD=n
CONFIG_CMD_BOOTFLOW=n
CONFIG_SYS_LONGHELP=n
CONFIG_CMD_FS_UUID=n
CONFIG_CMD_SETEXPR=n
CONFIG_USB_STORAGE=n
CONFIG_CMD_CONSOLE=n
CONFIG_BOOTM_LINUX=n
CONFIG_CMD_EDITENV=n
CONFIG_BOOTM_PLAN9=n
CONFIG_BOOTM_RTEMS=n
CONFIG_USE_PREBOOT=n
CONFIG_CMD_SAVEENV=n
CONFIG_CMD_PINMUX=n
CONFIG_VIDEO_LOGO=n
CONFIG_BOOTDELAY=-2
CONFIG_SYS_XTRACE=n
CONFIG_CMD_MEMORY=n
CONFIG_CMD_RANDOM=n
CONFIG_CMD_SOURCE=n
CONFIG_CMD_BOOTD=n
CONFIG_CMD_BOOTM=n
CONFIG_CMD_LOADS=n
CONFIG_CMD_LOADB=n
CONFIG_CMD_CRC32=n
CONFIG_CMD_ITEST=n
CONFIG_CMD_SLEEP=n
CONFIG_CMD_XIMG=n
CONFIG_CMD_GPIO=n
CONFIG_CMD_ECHO=n
CONFIG_CMD_ELF=n
CONFIG_CMD_IMI=n
CONFIG_CMD_RUN=n
CONFIG_CMD_FDT=n
CONFIG_CMD_I2C=n
CONFIG_CMD_CLS=n
CONFIG_CMD_DM=n
CONFIG_EXPERT=n
CONFIG_GZIP=n
CONFIG_NET=n
CONFIG_LTO=y
CONFIG_API=y
CONFIG_SYS_DCACHE_OFF=n
CONFIG_SYS_ICACHE_OFF=n
CONFIG_NO_FB_CLEAR=y
CONFIG_VIDEO_ANSI=y
```
